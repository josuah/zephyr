## dts/bindings/regulator/bflb,ldo15-rf-regulator.yaml
```yaml
# Copyright (c), 2026 MASSDRIVER EI (massdriver.space)
# SPDX-License-Identifier: Apache-2.0

include:
  - name: base.yaml
  - name: regulator.yaml
    property-allowlist:
      - regulator-always-on
      - regulator-boot-on

description: |
  Bouffalolab HBN AON (Always ON section) LDO15 RF (Radio) voltage regulator
  It is a LDO with a canonical voltage of 1.50v
  It has two modes, but they are only switched between when going into sleep mode and do not share
  settings areas.

compatible: "bflb,ldo15-rf-regulator"
```

## dts/bindings/regulator/bflb,ldo18-aon-regulator.yaml
```yaml
# Copyright (c), 2026 MASSDRIVER EI (massdriver.space)
# SPDX-License-Identifier: Apache-2.0

include:
  - name: base.yaml
  - name: regulator.yaml
    property-allowlist:
      - regulator-always-on
      - regulator-boot-on

description: |
  Bouffalolab HBN AON (Always ON section) LDO18 voltage regulator
  It is a LDO with a canonical voltage of 1.80v
  It has two modes, but they are only switched between when going into sleep mode and do not share
  settings areas.

compatible: "bflb,ldo18-aon-regulator"
```

## soc/bflb/common/Kconfig
```kconfig
# SPDX-License-Identifier: Apache-2.0

config BFLB_LPFW
	bool "Include the low-power firmware features"
	help
	  A vendor-provided binary runs in a dedicated retention RAM along with parameters and
	  after a CPU reset for its start address, handles the low-power operation with fewer
	  resources required than the main firmware, with the entire SoC powered off for everything
	  except the bare minimum for wireless operation.
```
