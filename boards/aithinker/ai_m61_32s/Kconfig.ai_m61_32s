## boards/aithinker/ai_m61_32s/Kconfig.ai_m61_32s
```kconfig
# Copyright (c) 2024-2025 MASSDRIVER EI (massdriver.space)
#
# SPDX-License-Identifier: Apache-2.0

config BOARD_AI_M61_32S
	select SOC_BL618M05Q2I
```

## boards/aithinker/ai_m61_32s/board.yml
```yaml
board:
  name: ai_m61_32s
  full_name: Ai-Thinker M61-32S development board
  vendor: aithinker
  socs:
    - name: bl618m05q2i
```

## drivers/usb/udc/Kconfig.dwc3
```kconfig
# Copyright (c) 2023 tinyVision.ai
# SPDX-License-Identifier: Apache-2.0

config UDC_DWC3
	bool "DesignWare USB device controller driver"
	imply UDC_WORKQUEUE
	default y
	depends on DT_HAS_SNPS_DWC3_USBD_ENABLED
	help
	  Synopsys DesignWare DWC3 USB device controller driver.
```

## dts/bindings/usb/snps,dwc3-usbd.yaml
```yaml
# Copyright (c) 2023 tinyVision.ai
# SPDX-License-Identifier: Apache-2.0

description: |
    Synopsys DesignWare DWC3 Controller in device mode

compatible: "snps,dwc3-usbd"

include: usb-ep.yaml

properties:
  reg:
    required: true

  # interrupts:
  #   required: true
```

## subsys/usb/common/Kconfig
```kconfig
# Copyright (c) 2025 Nordic Semiconductor ASA
#
# SPDX-License-Identifier: Apache-2.0

config USB_COMMON_UVC
	bool
	depends on USBD_VIDEO_CLASS || USBH_VIDEO_CLASS
```

## tests/drivers/build_all/input/testcase.yaml
```yaml
common:
  tags:
    - drivers
    - input
  build_only: true
tests:
  drivers.input.default: {}

  # Touchscreen drivers, non-default option
  drivers.input.touchscreen_interrupt:
    platform_allow:
      - native_sim
    extra_configs:
      - CONFIG_INPUT_CST816S_INTERRUPT=n
      - CONFIG_INPUT_FT5336_INTERRUPT=y
      - CONFIG_INPUT_GT911_INTERRUPT=y

  drivers.input.kbd_16_bit:
    platform_allow:
      - native_sim
    extra_configs:
      - CONFIG_INPUT_KBD_MATRIX_16_BIT_ROW=y

  drivers.input.analog_axis:
    platform_allow:
      - native_sim
    extra_configs:
      - CONFIG_ADC=y
      - CONFIG_SETTINGS=y

  drivers.input.adc_keys:
    platform_allow:
      - native_sim
    extra_configs:
      - CONFIG_ADC=y

  drivers.input.bflb_irx:
    platform_allow:
      - ai_m62_12f/bl616c50q2i
      - ai_wb2_12f/bl602c00q2i
```
