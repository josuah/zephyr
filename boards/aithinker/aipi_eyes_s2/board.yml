## boards/aithinker/aipi_eyes_s2/board.yml
```yaml
board:
  name: aipi_eyes_s2
  full_name: AiPi-Eyes-S2 Multi-Functional Development Board
  vendor: aithinker
  revision:
    format: custom
    default: "ALL"
    exact: true
    revisions:
      - name: "ALL"
  socs:
    - name: bl618m05q2i
      variants:
        - name: "safe_overclock"
        - name: "unsafe_overclock"
```

## boards/shields/arducam_mega/boards/nucleo_h563zi.conf
```kconfig
#
# Copyright (c) 2026 Mario Paja
#
# SPDX-License-Identifier: Apache-2.0
#

CONFIG_VIDEO_BUFFER_POOL_HEAP_SIZE=131072
CONFIG_VIDEO_FRAME_WIDTH=96
CONFIG_VIDEO_FRAME_HEIGHT=96
CONFIG_VIDEO_PIXEL_FORMAT="JPEG"
```

## drivers/video/Kconfig.bflb_dvp
```kconfig
# SPDX-FileCopyrightText: Copyright Panoramix Labs
# SPDX-License-Identifier: Apache-2.0

config VIDEO_BFLB_DVP
	bool "BouffaloLab DVP to AXI (DVP2AX) video receiver"
	default y
	depends on DT_HAS_BFLB_DVP_ENABLED
	select PINCTRL
	help
	  Enable driver for Bouffalo Lab DVP parallel camera (DVP) video receiver.

if VIDEO_BFLB_DVP

config VIDEO_BFLB_DVP_INIT_PRIORITY
	int "Bouffalo Lab DVP initialization priority"
	default 59
	help
	  System initialization priority for the BouffaloLab DVP drivers.
	  This priority needs to be lower (earlier) than VIDEO_INIT_PRIORITY (60) so that the MCLK
	  clock signal sent to the sensor is configured before, needed for I2C to respond.

endif
```

## dts/bindings/video/bflb,dvp.yaml
```yaml
#
# SPDX-FileCopyrightText: Copyright Panoramix Labs
# SPDX-License-Identifier: Apache-2.0
#

title: BouffaloLab DVP (Digital Video Port)

description: |
    The BouffaloLab DVP (Digital Video Port) is a video receiver for parallel camera video sources
    such as image sensors.

    Depending on the SoC, it features:

    - Input from a single DVP camera source per system
    - Pixel format conversion during reception
    - Several YUV and RGB input and output formats (availability depending on SoC)
    - Configurable frame dropping
    - Frame cropping/subsampling at reception time
    - Different HSYNC/VSYNC polarities
    - Optionally, buffer overwritten every frame

    Data is fed from the parallel signal of the camera, converted by a pixel processing engine,
    and fed into one of these AXI masters.

compatible: "bflb,dvp"

include: [base.yaml, pinctrl-device.yaml, reset-device.yaml]

properties:
  reg:
    required: true

  interrupts:
    required: true

child-binding:
  child-binding:
    include: video-interfaces.yaml

examples:
  - |
    &dvp {
      status = "okay";

      port {
        dvp_ep_in: endpoint {
          remote-endpoint-label = "ov2640_ep_out";
        };
      };
    };
```

## samples/subsys/video/capture/boards/aipi_cam_d200.conf
```kconfig
CONFIG_VIDEO_BUFFER_POOL_HEAP_SIZE=230400
CONFIG_VIDEO_BUFFER_POOL_ALIGN=32
CONFIG_VIDEO_BUFFER_POOL_ZEPHYR_REGION=y
CONFIG_VIDEO_BUFFER_POOL_ZEPHYR_REGION_NAME="PSRAM"
CONFIG_VIDEO_FRAME_HEIGHT=240
CONFIG_VIDEO_FRAME_WIDTH=240
CONFIG_VIDEO_PIXEL_FORMAT="RGBP"
```
